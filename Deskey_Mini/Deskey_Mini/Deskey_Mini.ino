#include <Wire.h>
#include <Adafruit_GFX.h>
#include <Adafruit_SSD1306.h>
#include <Adafruit_Sensor.h>
#include <DHT.h>


#include <NTPClient.h>
#include <ESP8266WiFi.h>
#include <WiFiUdp.h>


#define SCREEN_WIDTH 128  // OLED display width, in pixels
#define SCREEN_HEIGHT 64  // OLED display height, in pixels

// Declaration for an SSD1306 display connected to I2C (SDA, SCL pins)
Adafruit_SSD1306 display(SCREEN_WIDTH, SCREEN_HEIGHT, &Wire, -1);


#define DHTPIN 14  // Digital pin connected to the DHT sensor
// Uncomment the type of sensor in use:
#define DHTTYPE DHT11  // DHT 11
// #define DHTTYPE    DHT22     // DHT 22 (AM2302)
//#define DHTTYPE    DHT21     // DHT 21 (AM2301)

DHT dht(DHTPIN, DHTTYPE);


const char *ssid = "Edayady";
const char *password = "mynameismilanmilosh";


const long utcOffsetInSeconds = 19800;
char daysOfTheWeek[7][12] = { "Sunday", "Monday", "Tuesday", "Wednesday", "Thursday", "Friday", "Saturday" };


// Define NTP Client to get time
WiFiUDP ntpUDP;
NTPClient timeClient(ntpUDP, "asia.pool.ntp.org", utcOffsetInSeconds);


// 'lookleft', 128x64px
const uint8_t eye_lookleft[] PROGMEM = {
  0x00, 0x00, 0x00, 0x00, 0x00, 0x00, 0x00, 0x00, 0x00, 0x00, 0x00, 0x00, 0x00, 0x00, 0x00, 0x00,
  0x00, 0x00, 0x00, 0x00, 0x00, 0x00, 0x00, 0x00, 0x00, 0x00, 0x00, 0x00, 0x00, 0x00, 0x00, 0x00,
  0x00, 0x00, 0x00, 0x00, 0x00, 0x00, 0x00, 0x00, 0x00, 0x00, 0x00, 0x00, 0x00, 0x00, 0x00, 0x00,
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  0x00, 0x00, 0x00, 0x00, 0x00, 0x00, 0x00, 0x00, 0x00, 0x00, 0x00, 0x00, 0x00, 0x00, 0x00, 0x00
};
// 'lookright', 128x64px
const uint8_t eye_lookright[] PROGMEM = {
  0x00, 0x00, 0x00, 0x00, 0x00, 0x00, 0x00, 0x00, 0x00, 0x00, 0x00, 0x00, 0x00, 0x00, 0x00, 0x00,
  0x00, 0x00, 0x00, 0x00, 0x00, 0x00, 0x00, 0x00, 0x00, 0x00, 0x00, 0x00, 0x00, 0x00, 0x00, 0x00,
  0x00, 0x00, 0x00, 0x00, 0x00, 0x00, 0x00, 0x00, 0x00, 0x00, 0x00, 0x00, 0x00, 0x00, 0x00, 0x00,
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  0x00, 0x00, 0x00, 0x00, 0x00, 0x00, 0x00, 0x00, 0x00, 0x00, 0x00, 0x00, 0x00, 0x00, 0x00, 0x00
};
// 'nuetral', 128x64px
const uint8_t eye_nuetral[] PROGMEM = {
  0x00, 0x00, 0x00, 0x00, 0x00, 0x00, 0x00, 0x00, 0x00, 0x00, 0x00, 0x00, 0x00, 0x00, 0x00, 0x00,
  0x00, 0x00, 0x00, 0x00, 0x00, 0x00, 0x00, 0x00, 0x00, 0x00, 0x00, 0x00, 0x00, 0x00, 0x00, 0x00,
  0x00, 0x00, 0x00, 0x00, 0x00, 0x00, 0x00, 0x00, 0x00, 0x00, 0x00, 0x00, 0x00, 0x00, 0x00, 0x00,
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  0x00, 0x00, 0x00, 0x00, 0x00, 0x00, 0x00, 0x00, 0x00, 0x00, 0x00, 0x00, 0x00, 0x00, 0x00, 0x00
};
// 'squint', 128x64px
const uint8_t eye_squint[] PROGMEM = {
  0x00, 0x00, 0x00, 0x00, 0x00, 0x00, 0x00, 0x00, 0x00, 0x00, 0x00, 0x00, 0x00, 0x00, 0x00, 0x00,
  0x00, 0x00, 0x00, 0x00, 0x00, 0x00, 0x00, 0x00, 0x00, 0x00, 0x00, 0x00, 0x00, 0x00, 0x00, 0x00,
  0x00, 0x00, 0x00, 0x00, 0x00, 0x00, 0x00, 0x00, 0x00, 0x00, 0x00, 0x00, 0x00, 0x00, 0x00, 0x00,
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  0x00, 0x00, 0x00, 0x00, 0x00, 0x00, 0x00, 0x00, 0x00, 0x00, 0x00, 0x00, 0x00, 0x00, 0x00, 0x00
};
// 'sadeye1', 128x64px
const uint8_t eye_sad1[] PROGMEM = {
  0x00, 0x00, 0x00, 0x00, 0x00, 0x00, 0x00, 0x00, 0x00, 0x00, 0x00, 0x00, 0x00, 0x00, 0x00, 0x00,
  0x00, 0x00, 0x00, 0x00, 0x00, 0x00, 0x00, 0x00, 0x00, 0x00, 0x00, 0x00, 0x00, 0x00, 0x00, 0x00,
  0x00, 0x00, 0x00, 0x00, 0x00, 0x00, 0x00, 0x00, 0x00, 0x00, 0x00, 0x00, 0x00, 0x00, 0x00, 0x00,
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  0x00, 0x00, 0x00, 0x00, 0x00, 0x00, 0x00, 0x00, 0x00, 0x00, 0x00, 0x00, 0x00, 0x00, 0x00, 0x00
};
// 'sadeye2', 128x64px
const uint8_t eye_sad2[] PROGMEM = {
  0x00, 0x00, 0x00, 0x00, 0x00, 0x00, 0x00, 0x00, 0x00, 0x00, 0x00, 0x00, 0x00, 0x00, 0x00, 0x00,
  0x00, 0x00, 0x00, 0x00, 0x00, 0x00, 0x00, 0x00, 0x00, 0x00, 0x00, 0x00, 0x00, 0x00, 0x00, 0x00,
  0x00, 0x00, 0x00, 0x00, 0x00, 0x00, 0x00, 0x00, 0x00, 0x00, 0x00, 0x00, 0x00, 0x00, 0x00, 0x00,
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  0x00, 0x00, 0x00, 0x00, 0x00, 0x00, 0x00, 0x00, 0x00, 0x00, 0x00, 0x00, 0x00, 0x00, 0x00, 0x00
};


void setup() {

  Serial.begin(115200);

  if (!display.begin(SSD1306_SWITCHCAPVCC, 0x3C)) {
    Serial.println(F("SSD1306 allocation failed"));
    for (;;)
      ;
  }

  delay(1000);
  display.clearDisplay();  //All pixels are off

  dht.begin();

  wifi_connect();
}


void wifi_connect() {

  WiFi.begin(ssid, password);

  while (WiFi.status() != WL_CONNECTED) {

    delay(1000);
    Serial.print(".");
    display.clearDisplay();
    display.setTextColor(WHITE);
    display.setTextSize(1);
    display.setCursor(0, 32);
    display.println("WiFi not Connected");
    display.display();
  }

  delay(1000);
  Serial.println("WiFi Connected");
  display.clearDisplay();
  display.setTextColor(WHITE);
  display.setTextSize(1);
  display.setCursor(0, 32);
  display.println("WiFi Connected");
  display.display();
  delay(1000);
}

void temp_hum() {

  display.clearDisplay();

  //read temperature and humidity
  float t = dht.readTemperature();
  float h = dht.readHumidity();

  if (isnan(h) || isnan(t)) {
    Serial.println("Failed to read from DHT sensor!");
    display.clearDisplay();
    display.setTextColor(WHITE);
    display.setTextSize(1);
    display.setCursor(0, 32);
    display.println("DHT Failed");
    display.display();
    delay(1000);
  }

  // display
  display.setTextSize(1);
  display.setCursor(0, 0);
  display.print("Temperature: ");
  display.setTextSize(2);
  display.setCursor(0, 10);
  display.print(t);
  display.print(" ");
  display.setTextSize(1);
  display.cp437(true);
  display.write(167);
  display.setTextSize(2);
  display.print("C");

  // display humidity
  display.setTextSize(1);
  display.setCursor(0, 35);
  display.print("Humidity: ");
  display.setTextSize(2);
  display.setCursor(0, 45);
  display.print(h);
  display.print(" %");

  display.display();
}


void display_time(String week, String time) {

  display.clearDisplay();  //All pixels are off

  display.setTextColor(WHITE);
  display.setTextSize(2);  //Set the font size, support sizes from 1 to 8
  display.setCursor(0, 10);
  display.println(week);

  display.setTextColor(WHITE);  // Set the color of the text
  display.setTextSize(2);       //Set the font size, support sizes from 1 to 8
  display.setCursor(0, 36);    //Set the coordinates to start writing text
  display.println(time);        //Prints the characters at location x,y
  Serial.println(time);

  display.display();  // Call this method for the changes to make effect
}

void current_time() {

  timeClient.begin();
  timeClient.setTimeOffset(19800);  // Set time offset to UTC+5:30 (India)

  timeClient.update();

  Serial.print(daysOfTheWeek[timeClient.getDay()]);
  Serial.println(timeClient.getFormattedTime());

  String day_of_the_week = daysOfTheWeek[timeClient.getDay()];
  String formatted_24hr_time = timeClient.getFormattedTime();

  int hour = formatted_24hr_time.substring(0, 2).toInt();
  int minutes = formatted_24hr_time.substring(3, 5).toInt();
  // int seconds = formatted_24hr_time.substring(6, 8).toInt();

  // Determine AM or PM
  String period = (hour < 12) ? "AM" : "PM";

  // Convert hour to 12-hour format
  if (hour == 0) {
    hour = 12;
  } else if (hour > 12) {
    hour -= 12;
  }

  // Format the time
  String time_12hr = (hour < 10 ? "0" : "") + String(hour) + ":" + (minutes < 10 ? "0" : "") + String(minutes) + " " + period;

  display_time(day_of_the_week, time_12hr);

  delay(1000);
}


void blink_eye() {

  for (int i = 1; i <= 5; i += 1) {

    display.clearDisplay();
    display.drawBitmap(0, 0, eye_nuetral, 128, 64, WHITE);
    display.display();

    delay(1000);

    display.clearDisplay();
    display.drawBitmap(0, 0, eye_squint, 128, 64, WHITE);
    display.display();
  }

  display.clearDisplay();
  display.drawBitmap(0, 0, eye_nuetral, 128, 64, WHITE);
  display.display();

  delay(1000);

  display.clearDisplay();
  display.drawBitmap(0, 0, eye_lookleft, 128, 64, WHITE);
  display.display();

  delay(1000);

  display.clearDisplay();
  display.drawBitmap(0, 0, eye_nuetral, 128, 64, WHITE);
  display.display();

  delay(1000);

  display.clearDisplay();
  display.drawBitmap(0, 0, eye_squint, 128, 64, WHITE);
  display.display();

  display.clearDisplay();
  display.drawBitmap(0, 0, eye_nuetral, 128, 64, WHITE);
  display.display();

  display.clearDisplay();
  display.drawBitmap(0, 0, eye_lookright, 128, 64, WHITE);
  display.display();

  delay(1000);

  display.clearDisplay();
  display.drawBitmap(0, 0, eye_nuetral, 128, 64, WHITE);
  display.display();

  delay(1000);

  display.clearDisplay();
  display.drawBitmap(0, 0, eye_squint, 128, 64, WHITE);
  display.display();
}


void loop() {

  if (WiFi.status() == WL_CONNECTED) {

    blink_eye();
    current_time();
    delay(5000);
    temp_hum();
    delay(5000);

  } else {

    wifi_connect();
  }
}